#include "5110.h"
#include "delay.h"
void N5110_IO_Init(void)
{
	RCC->APB2ENR|=1<<4;	 //使能PORTC时钟
	RCC->APB2ENR|=1<<6;	 //使能PORTE时钟

	JTAG_Set(SWD_ENABLE);  //开启SWD,这里要关闭jtag模式
	GPIOC->CRH&=0XFFFFFFF0;
	GPIOC->CRH|=0X00000003;
	GPIOC->CRL&=0XF0FFFFFF;
	GPIOC->CRL|=0X03000000;// PC6,8推挽输出(用于5110的IO)
	
	GPIOE->CRL&=0XF0F0F0F0;
	GPIOE->CRL|=0X03030303;
	
	GPIOC->ODR|=1<<6;
	GPIOC->ODR|=1<<8;
  GPIOE->ODR|=1<<0;  // PB1输出高	//GPIOB->ODR|=0X34<<8;  //即00110100	 PA10 12 14输出高
	GPIOE->ODR|=1<<2;
	GPIOE->ODR|=1<<4;
	GPIOE->ODR|=1<<6;  	
 
//	RCC->APB2ENR|=1<<4;	 //使能PORTC时钟
//	GPIOC->CRL&=0X00FFFFFF;	  
//	GPIOC->CRL|=0X33000000;	  //PC5 6推挽输出
//	//GPIOC->ODR|=0XC0;		  //PC5 6输出高
//	GPIOC->ODR|=1<<5;
//	GPIOC->ODR|=1<<6;

}
const unsigned char   ASCII_6_8[][6] =
{
 {0x00, 0x00, 0x00, 0x00, 0x00, 0x00} // 20 (空格)
,{0x00, 0x00, 0x00, 0x5f, 0x00, 0x00} // 21 !
,{0x00, 0x00, 0x07, 0x00, 0x07, 0x00} // 22 "
,{0x00, 0x14, 0x7f, 0x14, 0x7f, 0x14} // 23 #
,{0x00, 0x24, 0x2a, 0x7f, 0x2a, 0x12} // 24 $
,{0x00, 0x23, 0x13, 0x08, 0x64, 0x62} // 25 %
,{0x00, 0x36, 0x49, 0x55, 0x22, 0x50} // 26 &
,{0x00, 0x00, 0x05, 0x03, 0x00, 0x00} // 27 '
,{0x00, 0x00, 0x1c, 0x22, 0x41, 0x00} // 28 (
,{0x00, 0x00, 0x41, 0x22, 0x1c, 0x00} // 29 )
,{0x00, 0x14, 0x08, 0x3e, 0x08, 0x14} // 2a *
,{0x00, 0x08, 0x08, 0x3e, 0x08, 0x08} // 2b +
,{0x00, 0x00, 0x50, 0x30, 0x00, 0x00} // 2c ,
,{0x00, 0x08, 0x08, 0x08, 0x08, 0x08} // 2d -
,{0x00, 0x00, 0x60, 0x60, 0x00, 0x00} // 2e .
,{0x00, 0x20, 0x10, 0x08, 0x04, 0x02} // 2f /
,{0x00, 0x3e, 0x51, 0x49, 0x45, 0x3e} // 30 0
,{0x00, 0x00, 0x42, 0x7f, 0x40, 0x00} // 31 1
,{0x00, 0x42, 0x61, 0x51, 0x49, 0x46} // 32 2
,{0x00, 0x21, 0x41, 0x45, 0x4b, 0x31} // 33 3
,{0x00, 0x18, 0x14, 0x12, 0x7f, 0x10} // 34 4
,{0x00, 0x27, 0x45, 0x45, 0x45, 0x39} // 35 5
,{0x00, 0x3c, 0x4a, 0x49, 0x49, 0x30} // 36 6
,{0x00, 0x01, 0x71, 0x09, 0x05, 0x03} // 37 7
,{0x00, 0x36, 0x49, 0x49, 0x49, 0x36} // 38 8
,{0x00, 0x06, 0x49, 0x49, 0x29, 0x1e} // 39 9
,{0x00, 0x00, 0x36, 0x36, 0x00, 0x00} // 3a :
,{0x00, 0x00, 0x56, 0x36, 0x00, 0x00} // 3b ;
,{0x00, 0x08, 0x14, 0x22, 0x41, 0x00} // 3c <
,{0x00, 0x14, 0x14, 0x14, 0x14, 0x14} // 3d =
,{0x00, 0x00, 0x41, 0x22, 0x14, 0x08} // 3e >
,{0x00, 0x02, 0x01, 0x51, 0x09, 0x06} // 3f ?
,{0x00, 0x32, 0x49, 0x79, 0x41, 0x3e} // 40 @
,{0x00, 0x7e, 0x11, 0x11, 0x11, 0x7e} // 41 A
,{0x00, 0x7f, 0x49, 0x49, 0x49, 0x36} // 42 B
,{0x00, 0x3e, 0x41, 0x41, 0x41, 0x22} // 43 C
,{0x00, 0x7f, 0x41, 0x41, 0x22, 0x1c} // 44 D
,{0x00, 0x7f, 0x49, 0x49, 0x49, 0x41} // 45 E
,{0x00, 0x7f, 0x09, 0x09, 0x09, 0x01} // 46 F
,{0x00, 0x3e, 0x41, 0x49, 0x49, 0x7a} // 47 G
,{0x00, 0x7f, 0x08, 0x08, 0x08, 0x7f} // 48 H
,{0x00, 0x00, 0x41, 0x7f, 0x41, 0x00} // 49 I
,{0x00, 0x20, 0x40, 0x41, 0x3f, 0x01} // 4a J
,{0x00, 0x7f, 0x08, 0x14, 0x22, 0x41} // 4b K
,{0x00, 0x7f, 0x40, 0x40, 0x40, 0x40} // 4c L
,{0x00, 0x7f, 0x02, 0x0c, 0x02, 0x7f} // 4d M
,{0x00, 0x7f, 0x04, 0x08, 0x10, 0x7f} // 4e N
,{0x00, 0x3e, 0x41, 0x41, 0x41, 0x3e} // 4f O
,{0x00, 0x7f, 0x09, 0x09, 0x09, 0x06} // 50 P
,{0x00, 0x3e, 0x41, 0x51, 0x21, 0x5e} // 51 Q
,{0x00, 0x7f, 0x09, 0x19, 0x29, 0x46} // 52 R
,{0x00, 0x46, 0x49, 0x49, 0x49, 0x31} // 53 S
,{0x00, 0x01, 0x01, 0x7f, 0x01, 0x01} // 54 T
,{0x00, 0x3f, 0x40, 0x40, 0x40, 0x3f} // 55 U
,{0x00, 0x1f, 0x20, 0x40, 0x20, 0x1f} // 56 V
,{0x00, 0x3f, 0x40, 0x38, 0x40, 0x3f} // 57 W
,{0x00, 0x63, 0x14, 0x08, 0x14, 0x63} // 58 X
,{0x00, 0x07, 0x08, 0x70, 0x08, 0x07} // 59 Y
,{0x00, 0x61, 0x51, 0x49, 0x45, 0x43} // 5a Z
,{0x00, 0x00, 0x7f, 0x41, 0x41, 0x00} // 5b [
,{0x00, 0x02, 0x04, 0x08, 0x10, 0x20} // 5c \ //
,{0x00, 0x00, 0x41, 0x41, 0x7f, 0x00} // 5d ]
,{0x00, 0x04, 0x02, 0x01, 0x02, 0x04} // 5e ^
,{0x00, 0x40, 0x40, 0x40, 0x40, 0x40} // 5f _
,{0x00, 0x00, 0x01, 0x02, 0x04, 0x00} // 60 `
,{0x00, 0x20, 0x54, 0x54, 0x54, 0x78} // 61 a
,{0x00, 0x7f, 0x48, 0x44, 0x44, 0x38} // 62 b
,{0x00, 0x38, 0x44, 0x44, 0x44, 0x20} // 63 c
,{0x00, 0x38, 0x44, 0x44, 0x48, 0x7f} // 64 d
,{0x00, 0x38, 0x54, 0x54, 0x54, 0x18} // 65 e
,{0x00, 0x08, 0x7e, 0x09, 0x01, 0x02} // 66 f
,{0x00, 0x0c, 0x52, 0x52, 0x52, 0x3e} // 67 g
,{0x00, 0x7f, 0x08, 0x04, 0x04, 0x78} // 68 h
,{0x00, 0x00, 0x44, 0x7d, 0x40, 0x00} // 69 i
,{0x00, 0x20, 0x40, 0x44, 0x3d, 0x00} // 6a j
,{0x00, 0x7f, 0x10, 0x28, 0x44, 0x00} // 6b k
,{0x00, 0x00, 0x41, 0x7f, 0x40, 0x00} // 6c l
,{0x00, 0x7c, 0x04, 0x18, 0x04, 0x78} // 6d m
,{0x00, 0x7c, 0x08, 0x04, 0x04, 0x78} // 6e n
,{0x00, 0x38, 0x44, 0x44, 0x44, 0x38} // 6f o
,{0x00, 0x7c, 0x14, 0x14, 0x14, 0x08} // 70 p
,{0x00, 0x08, 0x14, 0x14, 0x18, 0x7c} // 71 q
,{0x00, 0x7c, 0x08, 0x04, 0x04, 0x08} // 72 r
,{0x00, 0x48, 0x54, 0x54, 0x54, 0x20} // 73 s
,{0x00, 0x04, 0x3f, 0x44, 0x40, 0x20} // 74 t
,{0x00, 0x3c, 0x40, 0x40, 0x20, 0x7c} // 75 u
,{0x00, 0x1c, 0x20, 0x40, 0x20, 0x1c} // 76 v
,{0x00, 0x3c, 0x40, 0x30, 0x40, 0x3c} // 77 w
,{0x00, 0x44, 0x28, 0x10, 0x28, 0x44} // 78 x
,{0x00, 0x0c, 0x50, 0x50, 0x50, 0x3c} // 79 y
,{0x00, 0x44, 0x64, 0x54, 0x4c, 0x44} // 7a z
,{0x00, 0x00, 0x08, 0x36, 0x41, 0x00} // 7b {
,{0x00, 0x00, 0x00, 0x7f, 0x00, 0x00} // 7c |
,{0x00, 0x00, 0x41, 0x36, 0x08, 0x00} // 7d }
,{0x00, 0x10, 0x08, 0x08, 0x10, 0x08} // 7e ~
,{0x00, 0x78, 0x46, 0x41, 0x46, 0x78} // 7f (delete)
};
//特殊格式标志显示
const unsigned char   SIGN[][6]={						  //阳码0~9	 升降符号  编辑符号
{0xFF,0xC1,0xBE,0xBE,0xC1,0xFF},/*"0",0*/

{0xFF,0xBD,0x80,0xBF,0xFF,0xFF},/*"1",1*/
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{0x08,0x04,0x92,0xA8,0xA8,0x48},/*"/s",24*/





};

void LCD_write_byte(unsigned char dat, unsigned char command)
  {
    unsigned char i;
     LCD_SCE = 0;				  //5110片选有效，允许输入数据
    if (command == 0)			  //写命令
          LCD_DC = 0;				  
    else  LCD_DC = 1;			  //写数据
	for(i=0;i<8;i++)			  //传送8bit数据
		{ 
 	if(dat&0x80)		            
				SDIN = 1;
			else
				SDIN = 0;
			LCD_CLK = 0;
			dat = dat << 1;
			LCD_CLK = 1;          //时钟上升沿 写
	}
     LCD_SCE = 1;				   //禁止5110
  }


/*********************************************************** 
函数名称：LCD_init
函数功能：5110初始化
入口参数：无
出口参数：无 
备 注： 
***********************************************************/
void LCD5110_init(void)
  {
    LCD_SCE = 0;       // 片选LCD
	LCD_REST = 0;      // 产生一个让LCD复位的低电平脉冲
		delay_us(10);//10us最合适
    LCD_REST = 1;

    LCD_write_byte(0x21, 0);	// LCD模式设置:芯片活动，水平寻址，使用扩展指令
    LCD_write_byte(0xc4, 0);	// 设置液晶偏置电压
    LCD_write_byte(0x06, 0);	// 温度校正
    LCD_write_byte(0x13, 0);	// 1:48
    LCD_write_byte(0x20, 0);	// 使用基本命令，V=0，水平寻址
    LCD_clear();	           // 清屏
    LCD_write_byte(0x0c, 0);	// 设定显示模式，正常显示
   
    LCD_SCE = 1;      //禁止LCD
  }

/*********************************************************** 
函数名称：LCD_set_XY
函数功能：设置LCD坐标函数
入口参数：X       ：0－83  横坐标
          Y       ：0－5   纵坐标 
出口参数：无 
备 注： 
***********************************************************/
void LCD_set_XY(unsigned char X, unsigned char Y)
  {
      LCD_write_byte(0x80 | X, 0);        // X     行(横坐标)
	  LCD_write_byte(0x40 | Y, 0);		  // column	 列(纵坐标)
  }

/*------------------------------------------
LCD_clear: LCD清屏函数 
--------------------------------------------*/
void LCD_clear(void)
{
	unsigned char t;
	unsigned char k;
	LCD_set_XY(0,0);
	for(t=0;t<6;t++)
	{ 
		for(k=0;k<84;k++)
		{ 
			LCD_write_byte(0x00,1);
				
		} 
	}
}


void LCD_write_sign(uchar X,uchar Y,uchar char_num  )
{	
	unsigned char i;
	LCD_set_XY( X,Y );
	for(i=0;i<6;i++)
	{
		LCD_write_byte(SIGN[char_num][i], 1);	
	}	
}
/*********************************************************** 
函数名称：LCD_write_char
函数功能：显示英文字符
入口参数：c	:  显示的字符
出口参数：无 
备 注： 
***********************************************************/
void LCD_write_char(unsigned char c)
{
    unsigned char i; 
	 c-=0x20;                //ASCII码减去 0x20

    for (i=0; i<6; i++)
        LCD_write_byte(ASCII_6_8[c][i], 1);
}
/*-------------------------------------------
;名称: 英文字符串显示函数
;参数：*s：英文字符串指针
---------------------------------------------*/
void LCD_write_String(unsigned char X,unsigned char Y,unsigned char *s)
{
	LCD_set_XY(X,Y);
	while (*s) 	                 //等效*s!='\0'
	{
		LCD_write_char(*s);
		s++;
	}
} 
/************************显示转速函数***************************/
void zhuansu1( unsigned char X,unsigned char Y,unsigned int tem_value)
{
	unsigned char temp1;
	temp1=tem_value/100;
	tem_value=tem_value%100;
	LCD_set_XY(X,Y);
	LCD_write_char(temp1+'0');

	temp1=tem_value/10;
	tem_value=tem_value%10;
	LCD_set_XY(X+6,Y);
	LCD_write_char(temp1+'0');

//	LCD_write_char('.');

	LCD_set_XY(X+12,Y);
	LCD_write_char(tem_value+'0');
//	LCD_write_english_string(72,4,"n");  //显示信息
		
}
/*-------------------------------------------
;名称: 数值显示函数
;参数：number：数值 ;dot :小数点从左到右的位置
flag:0小数，1整数
---------------------------------------------*/
void LCD_write_number( unsigned char X,unsigned char Y,unsigned int number,u8 flag )
{
	uchar temp;
	LCD_set_XY(X, Y);

	if(flag==0)
	{
	
		temp=number/100+'0';
		LCD_write_char(temp);	
		number=number%100;
	
		temp=number/10+'0';
		LCD_write_char(temp);
		number=number%10;
	
		LCD_write_char('.');
	
		LCD_write_char(number+'0');
	}
	else
	{	
		temp=number/10+'0';
		LCD_write_char(temp);	
		number=number%10;

	 	LCD_write_char(number+'0');

	}
}
/*----------------------------------------------------
LCD_WRITE_ZH: 显示16（宽）*16（高）点阵列汉字等半角类
输入参数：zh：显示的汉字数组；index 汉字对应序号
---------------------------------------------------*/
void LCD_WRITE_ZH(unsigned char X, unsigned char Y,unsigned char  ZH[][32],unsigned char index) 
{
	unsigned char i;  	
	
	LCD_set_XY(X,Y);     //  汉字上部分
	for(i=0; i<16;i++) 
	{ 
		LCD_write_byte(ZH[index][i],1); 
	}
	
    LCD_set_XY(X, Y+1);  // 汉字下半部分
	for(i=16; i<32;i++) 
	{
		LCD_write_byte(ZH[index][i],1);
	}	
}		

/*-----------------------------------------------------------------------
LCD_WRITE_ZH_STRING: 在LCD上显示一串汉字

输入参数：X、Y    ：显示汉字的起始X、Y坐标；
           width ：汉字点阵的边长 
          index   ：汉字点阵数组中开始字符的索引号
		    num   ：从index开始要显示汉字的个数； 
          space   ：汉字显示的行间距

测试：			     X坐标  Y坐标   汉字串   汉字边宽  首字索引   字数    行间距       
	LCD_WRITE_ZH_STRING(0,      0,      hangzi,    16,        0,       5,      0);
-----------------------------------------------------------------------*/                        
void LCD_WRITE_ZH_STRING(uchar X,uchar Y,          // 起始坐标
                              uchar ZHS[][32],     // 汉字字符串
							  uchar width,         // 每个字符边长   
							  uchar index,         // 起始索引号
							  uchar num,		   // 显示个数
                   			  uchar space)         // 行间距
  {
    unsigned char i,n;
    
    LCD_set_XY(X,Y);                          //设置初始位置
    
    for (i=0; i<num; i++)                      //显示num个汉字
      {
      	for (n=0; n<width; n++)                //汉字上半部分
      	{
		   LCD_write_byte(ZHS[index+i][n],1);
		}                    
	   
	    LCD_set_XY((X+(width+space)*i),Y+1);   //写汉字的下半部分
	    for (n=width; n<width*2; n++)             
      	{
		   LCD_write_byte(ZHS[index+i][n],1);
		}    
      	      
      	LCD_set_XY((X+(width+space)*(i+1)),Y); //下一个汉字位置
      }
  }												

/*********************************************************** 
函数名称：LCD_draw_bmp_pixel
函数功能：位图绘制函数
入口参数：X、Y    ：位图绘制的起始X、Y坐标；
          *map    ：位图点阵数据；
          width   ：位图像素（长）
          height   ：位图像素（宽）
出口参数：无 
备 注： 
***********************************************************/
//void LCD_draw_bmp_pixel(uchar X,uchar Y,uchar *map, uchar width,uchar height)
//{
//   	  unsigned int i,n;
////    unsigned char X;
//    						    //计算位图所占行数
//      if (height%8==0) 	  	    //如果为位图所占行数为整数
//	     X=height/8;      
//      else
//         X=height/8+1;		//如果为位图所占行数不是整数
//    
//      LCD_set_XY(X,Y);
//      for (n=0;n<X;n++)		//换行
//      {	
//        for(i=0;i<width;i++)
//          {	
//		     LCD_set_XY(X+i,Y+n);
//             LCD_write_byte(map[i+n*width], 1);
//          }                         
//      }      
//}	
